/******************************************************************************
* File Name          : LTM022A69B.c
* Author             : WaveShare.
* Last Modified      : 12:19 2011-11-13
* Description        : This file provides the 
					   LTM022A69B LCD related functions' declaration.
******************************************************************************/

/* Includes -----------------------------------------------------------------*/
#include <LTM022A69B.h>
#include <ws_spi.h>
#include <gpio.h>

//#include "timer32.h"
/* Private typedef ----------------------------------------------------------*/

/* Private define -----------------------------------------------------------*/

/* Private macro ------------------------------------------------------------*/

/* Private variables --------------------------------------------------------*/

const u8 ascii[]=
{
    //8X16点阵的字符(共128个字符的点阵数据)
	0x00,0x00,0x00,0x00,0x00,0x00,0x00,0x00,0x00,0x00,0x00,0x00,0x00,0x00,0x00,0x00,	//0
	0x00,0x00,0x00,0x00,0x00,0x00,0x00,0x0F,0x08,0x08,0x08,0x08,0x08,0x08,0x08,0x00,
	0x00,0x00,0x00,0x00,0x00,0x00,0x00,0xF8,0x08,0x08,0x08,0x08,0x08,0x08,0x08,0x00,
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	0x00,0x00,0x00,0x00,0x00,0x00,0x00,0x00,0x00,0x00,0x00,0x00,0x00,0x00,0x00,0x00,
};

const u8 GB2312[][32]=
{
// 简体汉字点阵
// 字体：宋体   6个汉字
// 点阵：16×16
	// 微
0x11, 0x08, 0x15, 0x48, 0x25, 0x48, 0x45, 0x50, 0x97, 0xde, 0x10, 0x24, 0x20, 0x14, 0x6f, 0xd4, 
0xa0, 0x14, 0x27, 0x94, 0x24, 0x94, 0x24, 0xa8, 0x24, 0xc8, 0x24, 0x94, 0x28, 0x14, 0x30, 0x22, 

	// 雪
0x3f, 0xf8, 0x01, 0x00, 0x7f, 0xfe, 0x41, 0x02, 0x9d, 0x74, 0x01, 0x00, 0x1d, 0x70, 0x00, 0x00, 
0x3f, 0xf8, 0x00, 0x08, 0x00, 0x08, 0x1f, 0xf8, 0x00, 0x08, 0x00, 0x08, 0x3f, 0xf8, 0x00, 0x08, 

	// 电
0x01, 0x00, 0x01, 0x00, 0x01, 0x00, 0x3f, 0xf8, 0x21, 0x08, 0x21, 0x08, 0x21, 0x08, 0x3f, 0xf8, 
0x21, 0x08, 0x21, 0x08, 0x21, 0x08, 0x3f, 0xf8, 0x21, 0x0a, 0x01, 0x02, 0x01, 0x02, 0x00, 0xfe, 
	// 子
0x00, 0x00, 0x7f, 0xf8, 0x00, 0x10, 0x00, 0x20, 0x00, 0x40, 0x01, 0x80, 0x01, 0x00, 0xff, 0xfe, 
0x01, 0x00, 0x01, 0x00, 0x01, 0x00, 0x01, 0x00, 0x01, 0x00, 0x01, 0x00, 0x05, 0x00, 0x02, 0x00, 
	// 欢
0x00, 0x80, 0x00, 0x80, 0xfc, 0x80, 0x04, 0xfc, 0x05, 0x04, 0x49, 0x08, 0x2a, 0x40, 0x14, 0x40, 
0x10, 0x40, 0x28, 0xa0, 0x24, 0xa0, 0x45, 0x10, 0x81, 0x10, 0x02, 0x08, 0x04, 0x04, 0x08, 0x02,

	// 迎
0x00, 0x00, 0x20, 0x80, 0x13, 0x3c, 0x12, 0x24, 0x02, 0x24, 0x02, 0x24, 0xf2, 0x24, 0x12, 0x24, 
0x12, 0x24, 0x12, 0xb4, 0x13, 0x28, 0x12, 0x20, 0x10, 0x20, 0x28, 0x20, 0x47, 0xfe, 0x00, 0x00, 

    //您
0x09, 0x00, 0x09, 0x00, 0x11, 0xfc, 0x32, 0x04, 0x54, 0x48, 0x99, 0x50, 0x11, 0x48, 0x12, 0x44, 
0x14, 0x44, 0x11, 0x40, 0x10, 0x80, 0x02, 0x00, 0x51, 0x04, 0x51, 0x12, 0x90, 0x12, 0x0f, 0xf0,	
	/* 点阵结束 */
};


const u16 color[] =
{
	// 0 ~ 262143, 0x00000 ~ 0x3FFFF
	RED,	//red
	GREEN,	//green
	BLUE,	//blue
	YELLOW,	//yellow
	BLACK,	//black
	WHITE,	//white
	LIGHT_BLUE,	//light blue
	PURPLE	//purple
};   
/* Private function prototypes ----------------------------------------------*/

void Swap ( u16 *a , u16 *b );	//for BresenhamLine
void lcd_ctrl_port_init(void);      //nRS,nCS ... initialization

/* Private functions --------------------------------------------------------*/

//=============================================================================
//							LCD Basic Functions
//=============================================================================
/******************************************************************************
* Function Name  : LCD_WRITE_REG
* Description    : write LCD register
* Input          : index
* Output         : None
* Return         : None
******************************************************************************/

void LCD_WRITE_REG(u16 index)
{
	LCD_RS_L();
	LCD_CS_L();
    SPI0_communication((u8)(index>>8));    //00000000 000000000
    SPI0_communication((u8)(index));
	LCD_CS_H();
}

/******************************************************************************
* Function Name  : LCD_SEND_COMMAND
* Description    : send command to LCD
* Input          : index, data
* Output         : None
* Return         : None
******************************************************************************/
void LCD_SEND_COMMAND(u16 index,u16 data)
{
	//select command register
	LCD_RS_L();
	LCD_CS_L();
    SPI0_communication((u8)(index>>8));    //00000000 000000000
    SPI0_communication((u8)(index));
	LCD_CS_H();
	//send data
	LCD_RS_H();
	LCD_CS_L();
    SPI0_communication((u8)(data>>8));    //00000000 000000000
    SPI0_communication((u8)(data));
	LCD_CS_H();
}

/*******************************************************************************
* Function Name  : LCD_SEND_DATA
* Description    : write data to LCD
* Input          : None
* Output         : None
* Return         : None
*******************************************************************************/
void LCD_SEND_DATA(u16 data)
{
	u8 tmp;
	while(!(SPI_SR & 0x02));
	SPI0_communication((u8)(data>>8)); 
	while(!(SPI_SR & 0x01));
	tmp=SPI_DR;
	
	while(!(SPI_SR & 0x02));
	  SPI0_communication((u8)(data));
	while(!(SPI_SR & 0x01));
	tmp=SPI_DR;
}
/*
void LCD_SEND_DATA(u16 data)
{
    SPI0_communication((u8)(data>>8));    //00000000 000000000
    SPI0_communication((u8)(data));
}*/
/********************************************************************************
* Function Name  : lcd_ctrl_port_init
* Description    : nRS,nCS ... initialization  for LPC1114 PIN
* Input          : None
* Output         : None
* Return         : None
********************************************************************************/
void lcd_ctrl_port_init()
{

		PE_DDR|=(1<<3);PE_CR1|=(1<<3);//LCD_RST
		PE_DDR|=(1<<4);PE_CR1|=(1<<4);  //LCD_RS 
		PH_DDR|=(1<<2);PH_CR1|=(1<<2);  //LCD_CS  

}
/******************************************************************************
* Function Name  : lcd_init
* Description    : LCD initialization
* Input          : None
* Output         : None
* Return         : None
******************************************************************************/
void lcd_init(void)
{
    lcd_ctrl_port_init();
         SPI_Init();
	LCD_RST_L();
	LCD_RST_H();

	//register reset
	LCD_SEND_COMMAND(0x0003,0x0001);	//Soft reset (reset pulse occurs by writing in "1")

	//oscillator start
	LCD_SEND_COMMAND(0x003A,0x0001);	//Oscillator control (0:oscillator stop, 1: oscillator operation)

	//y-setting
	LCD_SEND_COMMAND(0x0024,0x007B);	//amplitude setting

	LCD_SEND_COMMAND(0x0025,0x003B);	//amplitude setting	
	LCD_SEND_COMMAND(0x0026,0x0034);	//amplitude setting

	LCD_SEND_COMMAND(0x0027,0x0004);	//amplitude setting	
	LCD_SEND_COMMAND(0x0052,0x0025);	//circuit setting 1

	LCD_SEND_COMMAND(0x0053,0x0033);	//circuit setting 2	
	LCD_SEND_COMMAND(0x0061,0x001C);	//adjustment V10 positive polarity

	LCD_SEND_COMMAND(0x0062,0x002C);	//adjustment V9 negative polarity
	LCD_SEND_COMMAND(0x0063,0x0022);	//adjustment V34 positive polarity

	LCD_SEND_COMMAND(0x0064,0x0027);	//adjustment V31 negative polarity

	LCD_SEND_COMMAND(0x0065,0x0014);	//adjustment V61 negative polarity

	LCD_SEND_COMMAND(0x0066,0x0010);	//adjustment V61 negative polarity
	
	//Basical clock for 1 line (BASECOUNT[7:0]) number specified
	LCD_SEND_COMMAND(0x002E,0x002D);
	
	//Power supply setting
	LCD_SEND_COMMAND(0x0019,0x0000);	//DC/DC output setting

	LCD_SEND_COMMAND(0x001A,0x1000);	//DC/DC frequency setting
	LCD_SEND_COMMAND(0x001B,0x0023);	//DC/DC rising setting
	LCD_SEND_COMMAND(0x001C,0x0C01);	//Regulator voltage setting
	LCD_SEND_COMMAND(0x001D,0x0000);	//Regulator current setting
	LCD_SEND_COMMAND(0x001E,0x0009);	//VCOM output setting
	LCD_SEND_COMMAND(0x001F,0x0035);	//VCOM amplitude setting	
	LCD_SEND_COMMAND(0x0020,0x0015);	//VCOMM cencter setting	
	LCD_SEND_COMMAND(0x0018,0x1E7B);	//DC/DC operation setting

	//windows setting
	LCD_SEND_COMMAND(0x0008,0x0000);	//Minimum X address in window access mode
	LCD_SEND_COMMAND(0x0009,0x00EF);	//Maximum X address in window access mode
	LCD_SEND_COMMAND(0x000a,0x0000);	//Minimum Y address in window access mode
	LCD_SEND_COMMAND(0x000b,0x013F);	//Maximum Y address in window access mode

	//LCD display area setting
	LCD_SEND_COMMAND(0x0029,0x0000);	//[LCDSIZE]  X MIN. size set
	LCD_SEND_COMMAND(0x002A,0x0000);	//[LCDSIZE]  Y MIN. size set
	LCD_SEND_COMMAND(0x002B,0x00EF);	//[LCDSIZE]  X MAX. size set
	LCD_SEND_COMMAND(0x002C,0x013F);	//[LCDSIZE]  Y MAX. size set	

	//Gate scan setting
	LCD_SEND_COMMAND(0x0032,0x0002);
	
	//n line inversion line number
	LCD_SEND_COMMAND(0x0033,0x0000);

	//Line inversion/frame inversion/interlace setting
	LCD_SEND_COMMAND(0x0037,0x0000);
	
	//Gate scan operation setting register
	LCD_SEND_COMMAND(0x003B,0x0001);
	
	//Color mode
	LCD_SEND_COMMAND(0x0004,0x0000);	//GS = 0: 260-k color (64 gray scale), GS = 1: 8 color (2 gray scale)

	//RAM control register
	LCD_SEND_COMMAND(0x0005,0x0010);	//Window access control (0: Normal access, 1: Window access)
	
	//Display setting register 2
	LCD_SEND_COMMAND(0x0001,0x0000);

	//display setting	
	LCD_SEND_COMMAND(0x0000,0x0000);	//display on

	
//	lcd_clear_screen(GREEN);
}

/******************************************************************************
* Function Name  : lcd_clear_screen
* Description    : clear screen
* Input          : color_background: refresh background color
* Output         : None
* Return         : None
******************************************************************************/
void lcd_clear_screen(u16 color_background)
{
	u16 i,j;

	LCD_SEND_COMMAND(0x08,0x00);
	LCD_SEND_COMMAND(0x0a,0x0000);
	LCD_SEND_COMMAND(0x09,0xEF);
	LCD_SEND_COMMAND(0x0b,0x013F);

	LCD_SEND_COMMAND(0x06,0x0000);
	LCD_SEND_COMMAND(0x07,0x0000);
	
	LCD_WRITE_REG(0x0E);	//RAM Write index

	LCD_CS_L();
	LCD_RS_H();

	for(i=0;i<320;i++)
	{
		for(j=0;j<240;j++)
		{
		  LCD_SEND_DATA(color_background);
		}
	}

	LCD_CS_H();
}
/******************************************************************************
* Function Name  : lcd_clear_area
* Description    : clear area,fill
* Input          : color_front:draw a rectangle, fill with color_front
                   x:
                   y:
                   width: rectangle width
                   height:rectangle height
* Output         : None
* Return         : None
******************************************************************************/
void lcd_clear_area(u16 color_front, 
                    u16 x, 
                    u16 y, 
                    u16 width, 
                    u16 height)
{
	u16 i, j;

	LCD_SEND_COMMAND( 0x08, x ); 	//x start point
	LCD_SEND_COMMAND( 0x0a, y ); 	//y start point
	LCD_SEND_COMMAND( 0x09, x + width - 1 );	//x end point
	LCD_SEND_COMMAND( 0x0b, y + height - 1 );	//y end point
		
	LCD_SEND_COMMAND( 0x06, x );
	LCD_SEND_COMMAND( 0x07, y );

	LCD_WRITE_REG( 0x0E );

	LCD_CS_L();
	LCD_RS_H();

	for( i = 0; i < height; i++ )
	{
		for( j = 0; j < width; j++ )
		{
			LCD_SEND_DATA( color_front );
		}
	}
	LCD_CS_H();
}

/******************************************************************************
* Function Name  : lcd_set_cursor
* Description    : Set cursor
* Input          : x, y
* Output         : None
* Return         : None
******************************************************************************/
void lcd_set_cursor(u16 x, u16 y)
{
  	if( (x > 320) || (y > 240) )
	{
		return;
	}
	LCD_SEND_COMMAND( 0x06, x );
	LCD_SEND_COMMAND( 0x07, y );
}

/******************************************************************************
* Function Name  : lcd_display_char
* Description    : ch_asc: ascii code of data. position_x, position_y.
					color_front, color_background.
* Input          : None
* Output         : None
* Return         : None
******************************************************************************/
void lcd_display_char(  u8 ch_asc, 
                        u16 color_front,
                        u16 color_background, 
                        u16 postion_x, 
                        u16 postion_y )
{
	u8 i, j, b;
	const u8 *p = 0;
	
	LCD_SEND_COMMAND(0x08,postion_x*8); 	//x start point
	LCD_SEND_COMMAND(0x0a,postion_y*16); 	//y start point
	LCD_SEND_COMMAND(0x09,postion_x*8+7);	//x end point
	LCD_SEND_COMMAND(0x0b,postion_y*16+15);	//y end point

	LCD_SEND_COMMAND(0x06,postion_x*8);	//RAM X address(0 ~ FF, actually 0 ~ EF)	
	LCD_SEND_COMMAND(0x07,postion_y*16);	//RAM Y address(0 ~ 1FF, actually 0 ~ 13F)
	
	LCD_WRITE_REG(0x0E);	//RAM Write index(prepare to write data)

	LCD_CS_L();
	LCD_RS_H();

	p = ascii;
	p += ch_asc*16;
	for(j=0;j<16;j++)
	{
		b=*(p+j);
		for(i=0;i<8;i++)
		{
			if( b & 0x80 )
			{
				LCD_SEND_DATA(color_front);
			}
			else
			{
				LCD_SEND_DATA(color_background);
			}
			b=b<<1;			
		}	
	}

	LCD_CS_H();
}

/******************************************************************************
* Function Name  : lcd_display_string
* Description    : *str: address of string data. 
					x: the xth row(0~30).
					y: the yth column(0~20).
					color_front, color_background.
* Input          : None
* Output         : None
* Return         : None
******************************************************************************/
void lcd_display_string(u8 *str, 
						u16 color_front, 
						u16 color_background, 
						u16 x, 
						u16 y )
{
	while (*str) 
	{ 
		lcd_display_char( *str, color_front, color_background, x, y);
		if(++x>=30)
		{
			x=0;
			if(++y>=20)
			{
				y=0;
			}
		}
		str ++;
    }
}

/******************************************************************************
* Function Name  : 汉字显示
* Description    : 16x16点阵的汉字显示函数
* Input          : gb:汉字对应字模中的位置，x:显示位置第几列，y:显示位置第几行
					color_front, color_background.  
* Output         : None
* Return         : None
******************************************************************************/
void lcd_display_GB2312(u8 gb, 
						u16 color_front, 
						u16 color_background, 
						u16 postion_x, 
						u16 postion_y )
{
	u8 i,j,b;
	u8 *p;
	
	LCD_SEND_COMMAND(0x08,postion_x*16); 	//x start point
	LCD_SEND_COMMAND(0x0a,postion_y*16); 	//y start point
	LCD_SEND_COMMAND(0x09,postion_x*16+15);	//x end point
	LCD_SEND_COMMAND(0x0b,postion_y*16+15);	//y end point
	LCD_SEND_COMMAND(0x06,postion_x*16);	
	LCD_SEND_COMMAND(0x07,postion_y*16);

	LCD_WRITE_REG(0x0E);	//RAM Write index

	LCD_CS_L();
	LCD_RS_H();

	p = (u8 *)GB2312;
	p += gb*32;
	for(j=0;j<32;j++)
	{
		b=*(p+j);
		for(i=0;i<8;i++)
		{
			if(b&0x80)
			{
				LCD_SEND_DATA(color_front);
			}
			else
			{
				LCD_SEND_DATA(color_background);
			}
			b=b<<1;
			
		}	
	}
	LCD_CS_H();
}

/******************************************************************************
* Function Name  : lcd_display_image
* Description    : Draw image
* Input          : *img : pointer of image data array[]
                   x, y: image start at x, y. 
                   width, height: image width,height.
* Output         : None
* Return         : None
******************************************************************************/
void lcd_display_image( const u8 *img, 
    					u16 x, 
    					u16 y, 
    					u16 width, 
    					u16 height )
{
	u16 i, j;
	u16 data16;

	LCD_SEND_COMMAND( 0x08, x ); 	//x start point
	LCD_SEND_COMMAND( 0x0a, y ); 	//y start point
	LCD_SEND_COMMAND( 0x09, x + width - 1 );	//x end point
	LCD_SEND_COMMAND( 0x0b, y + height - 1 );	//y end point
		
	LCD_SEND_COMMAND( 0x06, x );
	LCD_SEND_COMMAND( 0x07, y );

	LCD_WRITE_REG( 0x0E );

	LCD_CS_L();
	LCD_RS_H();

	for( i = 0; i < height; i++ )
	{
		for( j = 0; j < width; j++ )
		{
			//Be carful of MCU type, big endian or little endian
			//little endian
			data16 = ( *(img + 1) << 8 ) | (*img);
			LCD_SEND_DATA( data16 );
			img += 2;
		}
	}
	LCD_CS_H();
}

//=============================================================================
//							Application Functions
//=============================================================================

/******************************************************************************
* Function Name  : lcd_display_test
* Description    : test
* Input          : None
* Output         : None
* Return         : None
******************************************************************************/


void lcd_display_test(void)
{
	u16 temp, num;
	u16 i;
	u8 n;

    lcd_init();   //if you did not test lcd display, please uncomment this expression
	lcd_clear_screen(RED);				 //全屏显示红色

	LCD_SEND_COMMAND(0x08,0x00);		//x start point
	LCD_SEND_COMMAND(0x0a,0x0000);	//y start point
	LCD_SEND_COMMAND(0x09,0xEF);		//x end point
	LCD_SEND_COMMAND(0x0b,0x013F);	//y end point

	LCD_SEND_COMMAND(0x06,0x0000);
	LCD_SEND_COMMAND(0x07,0x0000);
	LCD_WRITE_REG(0x0E);	//prepare to send data
	//dispaly color bar
	for(n=0;n<8;n++)
	{
		LCD_CS_L();
		LCD_RS_H();
		temp=color[n];
		for(num=40*240;num>0;num--)
		{
			LCD_SEND_DATA(temp);
		}
	}


	//display pure color
	for(n=0;n<8;n++)
	{
		LCD_SEND_COMMAND(0x08,0x00);
		LCD_SEND_COMMAND(0x0a,0x0000);
		LCD_SEND_COMMAND(0x09,0xEF);
		LCD_SEND_COMMAND(0x0b,0x013F);

		LCD_SEND_COMMAND(0x06,0x0000);
		LCD_SEND_COMMAND(0x07,0x0000);
		
		LCD_WRITE_REG(0x0E);

		LCD_CS_L();
		LCD_RS_H();

	    temp=color[n];
		for(i=0;i<240;i++)
		{
			for(num=0;num<320;num++)
			{
		  		LCD_SEND_DATA(temp);
			}
		}
	}

	
	LCD_CS_H();


	lcd_clear_screen(GREEN);
    //显示“微雪电子欢迎您”
    lcd_display_GB2312(0,BLACK,GREEN,0,100);
    lcd_display_GB2312(1,BLACK,GREEN,1,100);
    lcd_display_GB2312(2,BLACK,GREEN,2,100);
    lcd_display_GB2312(3,BLACK,GREEN,3,100);
    lcd_display_GB2312(4,BLACK,GREEN,4,100);
    lcd_display_GB2312(5,BLACK,GREEN,5,100);
    lcd_display_GB2312(6,BLACK,GREEN,6,100);

}

/******************************************************************************
* Function Name  : lcd_draw_dot
* Description    : draw dot
* Input          : color, x, y
* Output         : None
* Return         : None
******************************************************************************/
void lcd_draw_dot(u16 color_front,u16 x,u16 y)
{
	LCD_SEND_COMMAND( 0x06, x );
	LCD_SEND_COMMAND( 0x07, y );
	LCD_SEND_COMMAND( 0x0E, color_front );
}

/******************************************************************************
* Function Name  : lcd_draw_bigdot
* Description    : draw big dot,9 pix.
* Input          : color_frong, x, y
* Output         : None
* Return         : None
******************************************************************************/
void lcd_draw_bigdot(u16   color_front,
                     u16    x,
                     u16    y )
{
    lcd_draw_dot(color_front,x,y);
    lcd_draw_dot(color_front,x,y+1);
    lcd_draw_dot(color_front,x,y-1);

    lcd_draw_dot(color_front,x+1,y);
    lcd_draw_dot(color_front,x+1,y+1);
    lcd_draw_dot(color_front,x+1,y-1);
    
    lcd_draw_dot(color_front,x-1,y);    
    lcd_draw_dot(color_front,x-1,y+1);
    lcd_draw_dot(color_front,x-1,y-1);
    
}

/******************************************************************************
* Function Name  : lcd_draw_line
* Description    : BresenhamLine
* Input          : c, x1, y1, x2, y2
* Output         : None
* Return         : None
******************************************************************************/
void lcd_draw_line(u16 color,
				   u16 x0, 
				   u16 y0, 
				   u16 x1, 
				   u16 y1){
 	u16 x,y;
 	u16 dx;      /* abs(x1 - x0) */
 	u16 dy;      /* abs(y1 - y0) */

	if(y0==y1)
	{
		if(x0<=x1)
		{
			x=x0;
		}
		else
		{
			x=x1;
			x1=x0;
		}
  		while(x <= x1)
  		{
   			lcd_draw_dot(color,x,y0);
   			x++;
  		}
  		return;
	}
	else if(y0>y1)
	{
		dy=y0-y1;
	}
	else
	{
		dy=y1-y0;
	}
 
 	if(x0==x1)
	{
		if(y0<=y1)
		{
			y=y0;
		}
		else
		{
			y=y1;
			y1=y0;
		}
  		while(y <= y1)
  		{
			lcd_draw_dot(color,x0,y);
   			y++;
  		}
  		return;
	}
	else if(x0 > x1)
 	{
		dx=x0-x1;
  		x = x1;
  		x1 = x0;
  		y = y1;
  		y1 = y0;
 	}
 	else
 	{
		dx=x1-x0;
  		x = x0;
  		y = y0;
 	}

 	if(dx == dy)
 	{
  		while(x <= x1)
  		{

   			x++;
			if(y>y1)
			{
				y--;
			}
			else
			{
   				y++;
			}
			lcd_draw_dot(color,x,y);
  		}
 	}
 	else
 	{
		lcd_draw_dot(color,x,y);
  		if(y < y1)
  		{
   			if(dx > dy)
   			{
    			s16 p = dy * 2 - dx;
    			s16 twoDy = 2 * dy;
    			s16 twoDyMinusDx = 2 * (dy - dx);
    			while(x < x1)
    			{
     				x++;
     				if(p < 0)
     				{
      					p += twoDy;
     				}
     				else
     				{
      					y++;
      					p += twoDyMinusDx;
     				}
					lcd_draw_dot(color,x,y);
    			}
   			}
   			{
    			s16 p = dx * 2 - dy;
    			s16 twoDx = 2 * dx;
    			s16 twoDxMinusDy = 2 * (dx - dy);
    			while(y < y1)
    			{
     				y++;
     				if(p < 0)
     				{
      					p += twoDx;
     				}
     				else
     				{
      					x++;
      					p+= twoDxMinusDy;
     				}
					lcd_draw_dot(color,x,y);
    			}
   			}
  		}
  		else
  		{
   			if(dx > dy)
   			{
    			s16 p = dy * 2 - dx;
    			s16 twoDy = 2 * dy;
	    		s16 twoDyMinusDx = 2 * (dy - dx);
    			while(x < x1)
    			{
     				x++;
     				if(p < 0)
	     			{
    	  				p += twoDy;
     				}
     				else
     				{
      					y--;
	      				p += twoDyMinusDx;
    	 			}
					lcd_draw_dot(color,x,y);
    			}
   			}
	   		else
   			{
    			s16 p = dx * 2 - dy;
    			s16 twoDx = 2 * dx;
	    		s16 twoDxMinusDy = 2 * (dx - dy);
    			while(y1 < y)
    			{
     				y--;
     				if(p < 0)
	     			{
    	  				p += twoDx;
     				}
     				else
     				{
      					x++;
	      				p+= twoDxMinusDy;
    	 			}
					lcd_draw_dot(color,x,y);
    			}
   			}
  		}
 	}
}

void Swap(u16 *a , u16 *b)	//for BresenhamLine
{
	u16 tmp;
	tmp = *a ;
	*a = *b ;
	*b = tmp ;
}
/**********************************************/
/* 函数功能；求m的n次方                       */
/**********************************************/
u32 mypow(u8 m,u8 n)
{
	u32 result=1;	 
	while(n--)result*=m;    
	return result;
}
/**********************************************/
/* 函数功能：显示数字                         */
/* 入口参数：x,y :起点坐标	 	              */
/*           num_len :数字的位数				  */
/*           num:数值(0~4294967295);	   	  */
/**********************************************/
void lcd_display_number(u16 x,
                        u16 y,
                        u32 num,
                        u8 num_len )
{         	
	u8 t,temp;
	u8 enshow=0;		 // 此变量用来去掉最高位的0	
				   
	for(t=0;t<num_len;t++)
	{
		temp=(num/mypow(10,num_len-t-1))%10;
		if(enshow==0&&t<(num_len-1))
		{
			if(temp==0)
			{
				//lcd_display_char(' ',BLACK,WHITE,x+8*t,y);
                lcd_display_char(' ',BLACK,WHITE,x+t,y);
				continue;
			}else enshow=1; 
		 	 
		}
	 	//lcd_display_char(temp+'0',BLACK,WHITE,x+8*t,y); 
        lcd_display_char(temp+'0',BLACK,WHITE,x+t,y); 
	}
} 
/********************************end of file**************************************/
